## firmware/sdkconfig.defaults
```kconfig
# --- Общие настройки для всех плат ---

# ML-KEM-1024 требует заметного стека при декапсуляции/генерации ключей.
CONFIG_ESP_MAIN_TASK_STACK_SIZE=24576

# --- Таблица разделов ---
# Штатный раздел приложения (1 МБ) прошивке уже мал: с ML-KEM, BLAKE3, mbedTLS и
# WiFi она перевалила за 1 МБ (на C6 сборка падала с "app partition is too
# small"). Своя таблица даёт 2 МБ под приложение — см. partitions.csv.
CONFIG_PARTITION_TABLE_CUSTOM=y
CONFIG_PARTITION_TABLE_CUSTOM_FILENAME="partitions.csv"
CONFIG_ESPTOOLPY_FLASHSIZE_4MB=y

# --- Оптимизация ---
# ВАЖНО ДЛЯ ЗАМЕРОВ. По умолчанию ESP-IDF собирает с -Og (отладочная сборка без
# оптимизации). На ней криптография работает в разы медленнее, чем в реальной
# прошивке, и измеренные цифры получаются несправедливо плохими. -Os даёт
# компактный и быстрый код: и раздел не переполняется, и замеры честные.
CONFIG_COMPILER_OPTIMIZATION_SIZE=y

# --- mbedTLS: примитивы протокола ---
# ChaCha20-Poly1305 в ESP-IDF выключен по умолчанию, и опция CHACHAPOLY зависит
# от POLY1305, а та — от CHACHA20. Если включить только CHACHAPOLY, Kconfig
# молча её отбросит, и линковка упадёт с "undefined reference to
# mbedtls_chachapoly_*". Поэтому включаем все три.
CONFIG_MBEDTLS_CHACHA20_C=y
CONFIG_MBEDTLS_POLY1305_C=y
CONFIG_MBEDTLS_CHACHAPOLY_C=y
CONFIG_MBEDTLS_ECDSA_C=y
CONFIG_MBEDTLS_ECP_DP_SECP256R1_ENABLED=y

# --- Аппаратное ускорение криптографии ---
# У ESP32-S3/C6 есть блок ускорения операций с большими числами (MPI) и SHA.
# Без них ECDSA считается чисто программно, и подпись занимает сотни
# миллисекунд. С ними — заметно быстрее. Для замеров это принципиально.
CONFIG_MBEDTLS_HARDWARE_MPI=y
CONFIG_MBEDTLS_HARDWARE_SHA=y
CONFIG_MBEDTLS_HARDWARE_AES=y
# Оптимизированная арифметика для кривых NIST (в т.ч. P-256).
CONFIG_MBEDTLS_ECP_NIST_OPTIM=y

# HTTP-клиент для регистрации на шлюзе (HTTPS не нужен — локальная сеть)
CONFIG_ESP_HTTP_CLIENT_ENABLE_HTTPS=n

CONFIG_NVS_ASSERT_ERROR_CHECK=n
CONFIG_LOG_DEFAULT_LEVEL_INFO=y
```

## firmware/sdkconfig.defaults.esp32c6
```kconfig
# XIAO ESP32-C6 (RISC-V, 160 МГц, одно ядро, флеш 4 МБ).
CONFIG_IDF_TARGET="esp32c6"

# У C6 есть аппаратный ускоритель эллиптических кривых (ECC), которого нет у
# ESP32-S3. Именно он делает подпись ECDSA P-256 на C6 в разы быстрее, несмотря
# на более слабый процессор. Включаем явно, чтобы это было воспроизводимо.
CONFIG_MBEDTLS_HARDWARE_ECC=y
```

## firmware/sdkconfig.defaults.esp32s3
```kconfig
# XIAO ESP32-S3 и ESP32-S3-DevKitC-1 (Xtensa, 240 МГц, два ядра).
CONFIG_IDF_TARGET="esp32s3"

# У S3 аппаратного ускорителя ECC НЕТ (в отличие от C6) — ECDSA считается
# программно, поэтому подпись заметно дороже. Ускорители больших чисел (MPI) и
# SHA включены в общем sdkconfig.defaults.

# Для ESP32-S3-N8R2 (8 МБ флеша + 2 МБ PSRAM) можно включить PSRAM:
# CONFIG_SPIRAM=y
# CONFIG_SPIRAM_MODE_QUAD=y
# CONFIG_SPIRAM_SPEED_80M=y
```
